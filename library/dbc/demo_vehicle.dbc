VERSION ""

NS_ :

BS_:

BU_: Vector__XXX

BO_ 123 EngineData: 8 Vector__XXX
 SG_ EngineSpeed : 0|16@1+ (0.25,0) [0|8000] "rpm" Vector__XXX
 SG_ EngineTemp : 16|8@1+ (1,-40) [-40|215] "degC" Vector__XXX

BO_ 256 VehicleSpeed: 4 Vector__XXX
 SG_ Speed : 0|16@1+ (0.01,0) [0|300] "km/h" Vector__XXX

BO_ 512 DoorStatus: 2 Vector__XXX
 SG_ DoorFrontLeft : 0|1@1+ (1,0) [0|1] "" Vector__XXX
 SG_ DoorFrontRight : 1|1@1+ (1,0) [0|1] "" Vector__XXX

VAL_ 123 EngineTemp 0 "Cold" 80 "Normal" 110 "Hot" ;
